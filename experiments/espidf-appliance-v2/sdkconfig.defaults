## experiments/espidf-appliance-v2/sdkconfig.defaults
```kconfig
# NAT/NAPT requirements for ESP-IDF lwIP.
CONFIG_LWIP_IP_FORWARD=y
CONFIG_LWIP_L2_TO_L3_COPY=y
CONFIG_LWIP_IPV4_NAPT=y
CONFIG_LWIP_NAPT=y

# Wi-Fi AP+STA appliance mode.
CONFIG_ESP_WIFI_SOFTAP_SUPPORT=y
CONFIG_ESP_WIFI_STA_DISCONNECTED_PM_ENABLE=n

# Minimal embedded dashboard.
CONFIG_HTTPD_MAX_REQ_HDR_LEN=1024
CONFIG_HTTPD_MAX_URI_LEN=512

# Flash/partition sanity for the bancada module detected as 4MB by esptool flash_id.
CONFIG_ESPTOOLPY_FLASHSIZE_4MB=y
CONFIG_ESPTOOLPY_FLASHSIZE="4MB"
CONFIG_PARTITION_TABLE_CUSTOM=y
CONFIG_PARTITION_TABLE_CUSTOM_FILENAME="partitions_4mb.csv"
CONFIG_PARTITION_TABLE_FILENAME="partitions_4mb.csv"
```

## experiments/nat-router-poc/sdkconfig.defaults
```kconfig
# NAT/NAPT requirements for ESP-IDF lwIP.
CONFIG_LWIP_IP_FORWARD=y
CONFIG_LWIP_L2_TO_L3_COPY=y
CONFIG_LWIP_IPV4_NAPT=y
CONFIG_LWIP_NAPT=y
CONFIG_ESP_WIFI_SOFTAP_SUPPORT=y
CONFIG_ESP_WIFI_STA_DISCONNECTED_PM_ENABLE=n
```
